## apps/amp_example/sample.yaml
```yaml
sample:
  description: This app provides an example of how to integrate OpenAMP
    with Zephyr including a resource table.
  name: OpenAMP with resource table example integration
tests:
  sample.subsys.ipc.openamp_rs_table:
    build_only: true
    platform_allow:
      - mpfs_icicle
    integration_platforms:
      - mpfs_icicle
```

## west.yml
```yaml
# Copyright (c) 2024 Microchip Technologies
# SPDX-License-Identifier: Apache-2.0

manifest:
  self:
    west-commands: scripts/west-commands.yml

  remotes:
    - name: zephyrproject-rtos
      url-base: https://github.com/zephyrproject-rtos
    - name: pmoussay-emdalo
      url-base: https://github.com/pmoussay-emdalo

  projects:
    - name: zephyr
      remote: zephyrproject-rtos
      revision: v3.6.0
      import:
        name-allowlist:
          - hal_microchip
    - name: hal_microchip
      remote: pmoussay-emdalo
      path: modules/hal/microchip
      revision: 0746d922bd0be125c1f20e2d31cff8c6b5a934b9
    - name: rpmsg-lite
      remote: pmoussay-emdalo
      path: modules/lib/rpmsg-lite
      revision: 7fc94efb2d8dbfa3d7c9212bcbb498fd3503af7a
      #  path-blocklist:
      #  - name: modules/hal/*
      #  - name: tools/*
```
